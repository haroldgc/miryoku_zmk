// Copyright 2021 Manna Harbour
// https://github.com/manna-harbour/miryoku

#if !defined (MIRYOKU_EP_TOG_COMBO)

/ {
    combos {
        compatible = "zmk,combos";
        combo_ep_tog {
            timeout-ms = <50>;
            key-positions = <20 32>;
            bindings = <&ext_power EP_TOG>;
        };
    };
};

#endif
